#include "keycodes.h"

mo_or_repeat: mo_layer_or_repeat {
  compatible = "zmk,behavior-hold-tap";
  label = "MO_REPEAT";
  #binding-cells = <2>;
  flavor = "hold-preferred";
  tapping-term-ms = <120>;
  bindings = <&mo>, <&key_repeat>;
};

#define NAV_RPT &mo_or_repeat NAV 0
