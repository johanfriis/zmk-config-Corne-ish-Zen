## config/boards/arm/zaphod/Kconfig.defconfig
```kconfig
# Copyright (c) 2020 Pete Johanson
# SPDX-License-Identifier: MIT

if BOARD_ZAPHOD

config BOARD
	default "zaphod"

config ZMK_KEYBOARD_NAME
	default "Zaphod"

if USB

config USB_NRFX
	default y

config USB_DEVICE_STACK
	default y

endif # USB

config BT_CTLR
	default BT

config ZMK_BLE
	default y

config ZMK_USB
	default y

config ZMK_BATTERY_VOLTAGE_DIVIDER
	default y

endif # BOARD_ZAPHOD
```

## config/boards/arm/zen/Kconfig
```kconfig
#
# Copyright (c) 2022 The ZMK Contributors
# SPDX-License-Identifier: MIT
#

config BOARD_ZEN_LEFT
	bool

config BOARD_ZEN_RIGHT
	bool
```

## config/boards/arm/zen/Kconfig.board
```kconfig
#
# Copyright (c) 2021 Darryl deHaan
# SPDX-License-Identifier: MIT
#

config BOARD_ZEN_LEFT
	bool "zen_left"
	depends on SOC_NRF52840_QIAA

config BOARD_ZEN_RIGHT
	bool "zen_right"
	depends on SOC_NRF52840_QIAA
```

## config/boards/arm/zen/Kconfig.defconfig
```kconfig
#
# Copyright (c) 2022 Darryl deHaan
# SPDX-License-Identifier: MIT
#

if BOARD_ZEN_LEFT

config ZMK_KEYBOARD_NAME
	default "Corne-ish Zen"

config ZMK_SPLIT_ROLE_CENTRAL
	default y

endif # BOARD_ZEN_LEFT

if BOARD_ZEN_LEFT || BOARD_ZEN_RIGHT

config BOARD
	default "zen"

config ZMK_SPLIT
	default y

config I2C
	bool
	default y

config BT_CTLR
	default BT

config ZMK_BLE
	default y

config ZMK_USB
	default y

menuconfig SENSOR
	bool "Sensor Drivers"

config BQ274XX
	bool "BQ274xx Fuel Gauge"
	depends on I2C && SENSOR

if USB

config USB_NRFX
	default y

config USB_DEVICE_STACK
	default y

endif # USB

endif # BOARD_ZEN_LEFT || BOARD_ZEN_RIGHT
```

## config/boards/arm/zen/zen_left_defconfig
```kconfig
#
# Copyright (c) 2022 Darryl deHaan
# SPDX-License-Identifier: MIT
#

CONFIG_SOC_SERIES_NRF52X=y
CONFIG_SOC_NRF52840_QIAA=y
CONFIG_BOARD_ZEN_LEFT=y
CONFIG_ZMK_SLEEP=y

# Enable MPU
CONFIG_ARM_MPU=y

# enable GPIO
CONFIG_GPIO=y

# Enable I2C
CONFIG_I2C=y
CONFIG_I2C_NRFX=y

# # Enable SPI
# CONFIG_SPI_NRFX=y

# Enable writing to flash
CONFIG_USE_DT_CODE_PARTITION=y
CONFIG_BUILD_OUTPUT_UF2=y
CONFIG_MPU_ALLOW_FLASH_WRITE=y
CONFIG_NVS=y
CONFIG_SETTINGS_NVS=y
CONFIG_FLASH=y
CONFIG_FLASH_PAGE_LAYOUT=y
CONFIG_FLASH_MAP=y

# Enable 32kHz crystal
CONFIG_CLOCK_CONTROL_NRF_K32SRC_XTAL=y
CONFIG_CLOCK_CONTROL_NRF_K32SRC_30PPM=y

# Turn on USB CDC ACM device
CONFIG_USB_DEVICE_STACK=y
CONFIG_USB_CDC_ACM=y
CONFIG_USB_CDC_ACM_RINGBUF_SIZE=1024

# Enable serial console
CONFIG_SERIAL=y
CONFIG_CONSOLE=y
CONFIG_UART_INTERRUPT_DRIVEN=y
CONFIG_UART_LINE_CTRL=y

# Enable USB UART
CONFIG_UART_CONSOLE=y
```

## config/west.yml
```yaml
manifest:
  remotes:
    - name: zmkfirmware
      url-base: https://github.com/zmkfirmware
    - name: johanfriis
      url-base: https://github.com/johanfriis
  projects:
    - name: zmk
      remote: johanfriis
      revision: main
      import: app/west.yml
  self:
    path: config
```
